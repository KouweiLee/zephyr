## boards/firefly/roc_rk3588_32/board.yml
```yaml
board:
  name: roc_rk3588_32
  full_name: ROC-RK3588_32 (Quad-core Cortex-A55)
  vendor: firefly
  socs:
  - name: rk3588_32
    # variants:
    # - name: smp
```

## boards/firefly/roc_rk3588_32/roc_rk3588_32_defconfig
```kconfig
# Copyright 2021 HNU-ESNL
# Copyright 2022 openEuler SIG-Zephyr
# SPDX-License-Identifier: Apache-2.0

# Platform Configuration
CONFIG_ARM_ARCH_TIMER=y

# Serial Drivers
CONFIG_SERIAL=y
CONFIG_UART_NS16550=y
CONFIG_UART_INTERRUPT_DRIVEN=y

# Enable console
CONFIG_CONSOLE=y
CONFIG_UART_CONSOLE=y

# ARMv8 NS world with cache management
CONFIG_CACHE_MANAGEMENT=y

# Clock controller support
```

## soc/rockchip/rk35/rk3588_32/Kconfig
```kconfig
# Copyright 2022 HNU-ESNL
# Copyright 2022 openEuler SIG-Zephyr
# SPDX-License-Identifier: Apache-2.0

config SOC_RK3588_32
	select ARM
	select CPU_CORTEX_A7
# select ARM_AARCH32_MMU


config SOC_PART_NUMBER
	default "RK3588_32" if SOC_RK3588_32
```

## soc/rockchip/rk35/rk3588_32/Kconfig.defconfig
```kconfig
# Copyright 2022 HNU-ESNL
# Copyright 2022 openEuler SIG-Zephyr
# SPDX-License-Identifier: Apache-2.0

if SOC_RK3588_32

rsource "Kconfig.defconfig.rk3588_32"

endif # SOC_RK3588_32
```
